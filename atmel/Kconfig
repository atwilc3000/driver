## atmel/Kconfig
```kconfig
menuconfig ATMEL_SMARTCONNECT
    bool "Atmel SmartConnect wireless cards Driver"
    depends on WLAN && CFG80211
#    select WIRELESS_EXT
#    select WEXT_PRIV
    ---help---
      This module adds support for wireless adapters based on
      Atmel chipsets.

if ATMEL_SMARTCONNECT

source "drivers/net/wireless/atmel/wilc1000/Kconfig"

endif
```

## wilc3000/Kconfig
```kconfig
config WILC3000
	tristate "WILC3000 support (WiFi & Bluetooth coexistence)"
    depends on CFG80211 && BT
	---help---
		This module supports Atmel IEEE 802.11n FullMAC and Bluetooth combo chipset.
		
		For more information on WILC3000 combo chipset visit:
		http://www.atmel.com/devices/ATWILC3000.aspx
		
		For information on all Atmel wireless products visit:
		http://www.atmel.com/products/wireless/default.aspx
		
choice
    prompt "BUS Type"
    depends on WILC3000 
    default WILC3000_SDIO
    
	config WILC3000_SDIO
	    bool "SDIO support"
	    depends on MMC
		---help---
			This module adds support for the SDIO interface of adapters using
			WILC3000 chipset. Select this if your platform is using the SDIO bus. 

	config WILC3000_SPI
	    bool "SPI support"
		---help---
			This module adds support for the SPI interface of adapters using
			WILC3000 chipset. Select this if your platform is using the SPI bus. 
endchoice


choice
	prompt "Memory Allocation"
	depends on WILC3000
	default WILC3000_DYNAMICALLY_ALLOCATE_MEMROY
		
	config WILC3000_STATICALLY_ALLOCATE_MEMORY
		bool "Statically allocate the memory for driver use"
		---help---
			This choice supports static allocation of the memory for the receive buffer. The driver
			will allocate the RX buffer during initial time. The driver will also free the buffer by calling
			network device stop.

	config WILC3000_DYNAMICALLY_ALLOCATE_MEMROY
		bool "Dynamically allocate memory for driver use in real time"
		---help---
			This choice supports dynamic allocation of the memory for the receive buffer. The driver
			will allocate the RX buffer when it is required. 
endchoice

config WILC3000_HW_OOB_INTR
        bool "Use out of band interrupt"
        depends on WILC3000 && WILC3000_SDIO
        default n
        ---help---
           Use out of band interrupt for wake on wireless instead of SDIO time devision interrupt.

config WILC3000_ENABLE_DEBUGFS
	bool "Export debugfs for WILC3000 status"
	depends on WILC3000
	default n
	---help---
	   Export status information via debugfs.
```
